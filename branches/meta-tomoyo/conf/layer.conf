## branches/meta-tomoyo/conf/layer.conf
```bitbake
BBPATH .= ":${LAYERDIR}"
BBFILES += "${LAYERDIR}/recipes-tomoyo/*.bb ${LAYERDIR}/recipes-tomoyo/*.bbappend"
```

## tags/ccs-patch/1.0.2/fs/Kconfig.ccs
```kconfig
config SAKURA
	bool "SAKURA (Domain-Free Mandatory Access Control) support"
	default n
	help
	  Say Y here to support the Domain-Free Mandatory Access Control.

	  SAKURA stands for
	  "Security Advancement Know-how Upon Read-only Approach".
	  As the name shows, SAKURA was originally a methodology to make
	  root fs read-only to avoid tampering the system files.
	  But now, SAKURA is not only a methodology but also a kernel patch
	  that improves the system security with less effort.

	  SAKURA can restrict operations that affect systemwide.

	  SAKURA can drop unnecessary capabilities
	  to reduce the risk of exploitations.

config SAKURA_RESTRICT_MOUNT
	bool "  mount() restriction support"
	default y
	depends on SAKURA
	help
	  This option allows you to restrict combinations of
	  (type, device, dir) that the system can mount.

	  For example, the WWW contents are stored at /var/www directory
	  in a HDD, if tmpfs is mounted on /var/www by an attacker,
	  the WWW contents will be hidden.
	  You can prevent the attacker from mounting tmpfs on /var/www
	  with this option.

config SAKURA_RESTRICT_CHROOT
	bool "  chroot() restriction support"
	default y
	depends on SAKURA
	help
	  This option allows you to restrict directories
	  that the system can chroot to.

	  If an attacker can chroot to arbitrary directories,
	  the attacker can create a directory tree with malicious programs
	  under a writable directory
	  and execute them after chroot to that directory.
	  You can prevent the attacker with this option.

	  This option becomes more powerful if either root fs is read-only
	  or mandatory file access controls are enforced.

config SAKURA_RESTRICT_UNMOUNT
	bool "  umount() restriction support"
	default y
	depends on SAKURA
	help
	  This option allows you to reject unmount requests
	  for specific directories.

	  For example, many programs refer /proc,
	  so if /proc is unmounted by an attacker,
	  the system will go wrong.
	  You can prevent the attacker from unmounting
	  /proc with this option.

config SAKURA_TRACE_READONLY
	bool "  Read-only filesystem error tracing support"
	default y
	depends on SAKURA
	help
	  This option allows you to dump pathnames
	  which a write operation has failed due to read-only filesystem.
	  (Currently, not all operations are supported.)

	  Some programs abort silently if a write operation
	  failed unexpectedly.

	  This option is useful when you are trying to make
	  root fs read only, for you can find files and directories
	  that have to be writable
	  by mounting root fs read-only and running the system.

config SAKURA_DENY_CONCEAL_MOUNT
	bool "  Conceal mount disabler support"
	default y
	depends on SAKURA
	help
	  This option allows you to prevent mount requests
	  that conceals existing mounts.

	  For example, if tmpfs is mounted on /dev or /dev/shm
	  when /dev/shm is already mounted, the files in /dev/shm
	  will be hidden.
	  You can prevent such cases with this option.

config SAKURA_DENY_PIVOT_ROOT
	bool "  pivot_root() disabler support"
	default y
	depends on SAKURA
	help
	  This option allows you to disable pivot_root
	  after /sbin/init starts.

	  In most systems, pivot_root is not used
	  after /sbin/init starts.

config SAKURA_RESTRICT_AUTOBIND
	bool "  Autobind restriction support"
	default y
	depends on SAKURA
	help
	  This option allows you to prevent specific local ports
	  from being assigned by automatic port assignment function
	  (which is called by "bind() with port = 0" or
	  "connect() without bind()").

	  For example, some proxy server uses port 8080, so this port
	  should not be assigned by automatic port assignment function.

	  You can create a single local ports range
	  for automatic port assignment function
	  via /proc/sys/net/ipv4/ip_local_port_range .
	  This option allows you to divide the single range into multiple.

config SAKURA_DROP_CAPABILITY_API
	bool "  Dropping capabilities interface support (EXPERIMENTAL)"
	default n
	depends on SAKURA
	help
	  This option allows userland application developers to drop
	  unnecessary capabilities to reduce the risk of exploitations.

	  The capabilities in SAKURA are not the Linux (POSIX) capabilities.
	  The capabilities in SAKURA are the boolean flags of system calls
	  that a process can call.

	  The way of regular access control is
	  "Grant necessary capabilities by the administrator",
	  but the way of this access control is
	  "Drop unnecessary capabilities by the application developers".
	  The userland program developers know what capabilities
	  their program need, but the userland program users don't know.
	  So, dropping unnecessary capabilities from existing capabilities
	  is handier than granting necessary capabilities from zero.

	  Since patching to userland programs (i.e. adding a few lines
	  and recompile) are required, this option is disabled by default.

config TOMOYO
	bool "TOMOYO (Domain-Based Mandatory Access Control) support"
	default n
	help
	  Say Y here to support the Domain-Based Mandatory Access Control.

	  TOMOYO stands for "Task Oriented Management Obviates Your Onus".
	  TOMOYO is intended to provide the Domain-Based MAC
	  utilizing task_struct.

	  The word "domain" in TOMOYO is a class that a process
	  (i.e. task_struct) belong to.
	  The domain of a process changes whenever the process
	  executes a program.
	  This allows you to classify at the finest level.
	  The access permission is granted to domains, not to processes.
	  Policy is defined as "Which domain can access to which resource.".
	  There is no concept of "user id" nor "role" like RBAC.

	  The biggest feature of TOMOYO is that TOMOYO has "accept mode".
	  The accept mode can automatically generate policy definition,
	  and dramatically reduces the policy definition labors.

	  TOMOYO is much simpler and easier than SELinux.

	  TOMOYO is applicable to figuring out the system's behavior, for
	  TOMOYO uses the canonicalized absolute pathnames and
	  TreeView style domain transitions.

	  You can make custom root fs with minimum files
	  to run minimum applications with TOMOYO.

config TOMOYO_MAC_FOR_FILE
	bool "  File Access Control support"
	default y
	depends on TOMOYO
	help
	  Say Y here to support the MAC for file access.

	  This is the main feature of TOMOYO.
	  If you don't say Y to this option,
	  you can't improve the system security.

config TOMOYO_MAC_FOR_BINDPORT
	bool "  Local Port Control support"
	default y
	depends on TOMOYO
	help
	  Say Y here to support the MAC for local port assignment.

	  This option allows you to restrict local port numbers
	  that a domain can bind.
	  For example, you can use this option to allow HTTP server
	  to bind to only TCP/80 and TCP/443.

config TOMOYO_MAC_FOR_CONNECTPORT
	bool "  Remote Port Control support"
	default y
	depends on TOMOYO
	help
	  Say Y here to support the MAC for remote port assignment.

	  This option allows you to restrict remote port numbers
	  that a domain can connect or send data.
	  For example, you can use this option to allow FTP client
	  to connect to only TCP/20 and TCP/21.

config TOMOYO_MAC_FOR_SIGNAL
	bool "  Signal Control support"
	default y
	depends on TOMOYO
	help
	  Say Y here to support the MAC for signal delivery.

	  This option allows you to restrict
	  the combination of (signal number, destination domain)
	  that a domain can deliver.

	  Without this option, any process that are running as root
	  can kill arbitrary processes.

config TOMOYO_MAC_FOR_CAPABILITY
	bool "  Capability Control support"
	default y
	depends on TOMOYO
	help
	  Say Y here to support the MAC for capabilities.

	  The capabilities in TOMOYO are not the Linux (POSIX) capabilities.
	  The capabilities in TOMOYO are the boolean flags of system calls
	  that a domain can call.

	  You should say Y to this option, for the policy syntax can't
	  distinguish regular files, FIFOs, unix domain sockets,
	  symbolic links and device files.
	  This option allows you to restrict type of files
	  that a domain can create using mknod.

config TOMOYO_MAX_ACCEPT_FILES
	int "  Default maximal count for accept mode (0-1048576)"
	default 256
	range 0 1048576
	depends on TOMOYO
	help
	  This is the default value for maximal entries for file access
	  that are automatically appended into policy at "accept mode".
	  Some programs access thousands of files, so running 
	  such programs in "accept mode" dulls the system response
	  and consumes much memory.
	  This is the safeguard for such programs.

config TOMOYO_MAX_GRANT_LOG
	int "  Maximal count for grant log (0-1024)"
	default 1024
	range 0 1024
	depends on TOMOYO
	help
	  This is the maximal value for access grant logs
	  that the kernel can hold on memory.
	  You can read the log via /proc/ccs/info/grant_log.
	  If you don't need access grant logs,
	  you may set this value to 0.

config TOMOYO_MAX_REJECT_LOG
	int "  Maximal count for reject log (0-1024)"
	default 1024
	range 0 1024
	depends on TOMOYO
	help
	  This is the maximal value for access reject logs
	  that the kernel can hold on memory.
	  You can read the log via /proc/ccs/info/reject_log.
	  If you don't need access reject logs,
	  you may set this value to 0.

config SYAORAN
	tristate "SYAORAN (Tamper-Proof Device Filesystem) support"
	default n
	help
	  Say Y or M here to support the Tamper-Proof Device Filesystem.

	  SYAORAN stands for
	  "Simple Yet All-important Object Realizing Abiding Nexus".
	  SYAORAN is a filesystem for /dev with Mandatory Access Control.

	  SAKURA can make root fs read-only, but the system can't work
	  if /dev is read-only. Therefore you need to mount a writable
	  filesystem (such as tmpfs) for /dev if root fs is read-only.

	  But the writable /dev means that files on /dev might be tampered.
	  For example, if /dev/null is deleted and re-created as a symbolic
	  link to /dev/hda by an attacker, the contents of the IDE HDD
	  will be destroyed at a blow.
 
	  Also, TOMOYO controls file access by pathnames,
	  not by security labels.
	  Therefore /dev/null, for example, might be tampered
	  if a process have write permission to /dev/null .

	  SYAORAN can ensure /dev/null is a character device file
	  with major=1 minor=3.

	  You can use SAKURA to make /dev not unmountable.
```

## tags/ccs-patch/1.6.9p2/fs/Kconfig.ccs
```kconfig
config SAKURA
	bool "SAKURA (Domain-Free Mandatory Access Control) support"
	default y
	help
	  Say Y here to support the Domain-Free Mandatory Access Control.

	  SAKURA stands for
	  "Security Advancement Know-how Upon Read-only Approach".
	  As the name shows, SAKURA was originally a methodology to make
	  root fs read-only to avoid tampering the system files.
	  But now, SAKURA is not only a methodology but also a kernel patch
	  that improves the system security with less effort.

	  SAKURA can restrict operations that affect systemwide.

config TOMOYO
	bool "TOMOYO (Domain-Based Mandatory Access Control) support"
	default y
	help
	  Say Y here to support the Domain-Based Mandatory Access Control.

	  TOMOYO stands for "Task Oriented Management Obviates Your Onus".
	  TOMOYO is intended to provide the Domain-Based MAC
	  utilizing task_struct.

	  The word "domain" in TOMOYO is a class that a process
	  (i.e. task_struct) belong to.
	  The domain of a process changes whenever the process
	  executes a program.
	  This allows you to classify at the finest level.
	  The access permission is granted to domains, not to processes.
	  Policy is defined as "Which domain can access to which resource.".

	  The biggest feature of TOMOYO is that TOMOYO has "learning mode".
	  The learning mode can automatically generate policy definition,
	  and dramatically reduces the policy definition labors.

	  TOMOYO is applicable to figuring out the system's behavior, for
	  TOMOYO uses the canonicalized absolute pathnames and
	  TreeView style domain transitions.

	  You can make custom root fs with minimum files
	  to run minimum applications with TOMOYO.

config TOMOYO_MAX_ACCEPT_ENTRY
	int "Default maximal count for learning mode"
	default 2048
	range 0 2147483647
	depends on TOMOYO
	help
	  This is the default value for maximal ACL entries
	  that are automatically appended into policy at "learning mode".
	  Some programs access thousands of objects, so running
	  such programs in "learning mode" dulls the system response
	  and consumes much memory.
	  This is the safeguard for such programs.

config TOMOYO_BUILTIN_INITIALIZERS
	string "Built-in domain initializer programs"
	default "/sbin/modprobe /sbin/hotplug"
	depends on TOMOYO
	---help---
	  Some programs are executed from initrd/initramfs before /sbin/init
	  starts.

	  Since policy is loaded when /sbin/init starts, it is impossible to
	  run such programs outside the <kernel> domain. Usually it is fine.

	  But if such programs continue running when /sbin/init starts, such
	  programs will reside in the <kernel> domain.
	  If such programs executes /bin/sh , you will give the <kernel> domain
	  permission to execute /bin/sh ; I think you don't want to do so.

	  This option allows you to chase such programs away from the <kernel>
	  domain so that you won't give the <kernel> domain permission to
	  execute /bin/sh .

config TOMOYO_AUDIT
	bool "Auditing interface support"
	default y
	depends on TOMOYO
	help
	  This option enables /proc/ccs/grant_log and /proc/ccs/reject_log
	  interfaces. You may disable these interfaces if you want to apply for
	  HDD-less systems (e.g. embedded systems).

config TOMOYO_MAX_GRANT_LOG
	int "Default maximal count for grant log"
	default 1024
	range 0 2147483647
	depends on TOMOYO_AUDIT
	help
	  This is the default value for maximal entries for
	  access grant logs that the kernel can hold on memory.
	  You can read the log via /proc/ccs/grant_log.
	  If you don't need access grant logs,
	  you may set this value to 0.

config TOMOYO_MAX_REJECT_LOG
	int "Default maximal count for reject log"
	default 1024
	range 0 2147483647
	depends on TOMOYO_AUDIT
	help
	  This is the default value for maximal entries for
	  access reject logs that the kernel can hold on memory.
	  You can read the log via /proc/ccs/reject_log.
	  If you don't need access reject logs,
	  you may set this value to 0.

config SYAORAN
	tristate "SYAORAN (Tamper-Proof Device Filesystem) support"
	default m
	help
	  Say Y or M here to support the Tamper-Proof Device Filesystem.

	  SYAORAN stands for
	  "Simple Yet All-important Object Realizing Abiding Nexus".
	  SYAORAN is a filesystem for /dev with Mandatory Access Control.

	  SAKURA can make root fs read-only, but the system can't work
	  if /dev is read-only. Therefore you need to mount a writable
	  filesystem (such as tmpfs) for /dev if root fs is read-only.

	  But the writable /dev means that files on /dev might be tampered.
	  For example, if /dev/null is deleted and re-created as a symbolic
	  link to /dev/hda by an attacker, the contents of the IDE HDD
	  will be destroyed at a blow.

	  Also, TOMOYO controls file access by pathnames,
	  not by security labels.
	  Therefore /dev/null, for example, might be tampered
	  if a process have write permission to /dev/null .

	  SYAORAN can ensure /dev/null is a character device file
	  with major=1 minor=3.

	  You can use SAKURA to make /dev not unmountable.
```
